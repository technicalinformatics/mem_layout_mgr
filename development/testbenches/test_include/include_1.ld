INCLUDE  hello
INCLUDE  hello2

MEMORY {
rom (rx)  : ORIGIN = 0, LENGTH = 256K
rom (rx)  : ORIGIN = 0, LENGTH = 256K
rom (rx)  : ORIGIN = 0 LENGTH = 256K
rom (rx)  : ORIGIN = 0, LENGTH = 256K
 }  

MEMORY { }