MEMORY 
{
    rom   : ORIGIN = 0, LENGTH = 256K
    rom (r)  : ORIGIN = 0, LENGTH = 256K
    rom (!r)  : ORIGIN = 0, LENGTH = 256K
    rom (rx)  : ORIGIN = 0, LENGTH = 256K
    rom (!rx)  : ORIGIN = 0, LENGTH = 256K
}
